## conf/layer.conf
```bitbake
# We have a conf and classes directory, append to BBPATH
BBPATH .= ":${LAYERDIR}"

BBFILES += "\
    ${LAYERDIR}/recipes*/*/*.bb \
    ${LAYERDIR}/recipes*/*/*.bbappend \
"

BBFILE_COLLECTIONS += "vulkan-layer"
BBFILE_PATTERN_vulkan-layer := "^${LAYERDIR}/"
BBFILE_PRIORITY_vulkan-layer = "12"

LAYERRECOMMENDS_vulkan-layer = " \
    qt5-layer \
"

LAYERSERIES_COMPAT_vulkan-layer = "whinlatter"

BBFILES_DYNAMIC += " \
    qt5-layer:${LAYERDIR}/dynamic-layers/qt5-layer/*/*/*.bb \
    qt5-layer:${LAYERDIR}/dynamic-layers/qt5-layer/*/*/*/*.bb \
    qt5-layer:${LAYERDIR}/dynamic-layers/qt5-layer/*/*/*.bbappend \
"
```
